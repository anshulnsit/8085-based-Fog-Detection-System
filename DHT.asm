	JMP LABEL0
.ORG 003CH
	JMP ISR75
.ORG 0050
MAIN:	CALL LCD_INIT
	CALL WELCOME
	CALL DELAY_1 ; 1 sec delay	
	MVI A,C0H
	SIM
	CALL DELAY_20
	MVI A,40H
	SIM
	CALL DELAY_20U
L1:	RIM
	ANI 80H
	JZ L1
L2:	RIM
	ANI 80H
	JNZ L2
	LXI D,
	MVI A,30H ; CONTROL WORD FOR 8254
	OUT 03H ; PORT ADDRESS OF CONTROL REGISTER
	MVI A,FFH ; LOW ORDER BYTE
	OUT 00H
	MVI A,FFH ; HIGH ORDER BYTE
	OUT 00H
	EI
	MVI A,29H
L3:	JNZ L3
	DI
	
	
		
LABEL0:	CALL LCD_INIT
	MVI A,33H
	CALL LCD_SEND
	MVI A,37H
	CALL LCD_SEND
	HLT

DELAY_20:   	PUSH B
	LXI B,681H
LOOP_20:	DCX B
	MOV A,B
	ORA C
	JNZ LOOP_20
	POP B
	RET

DELAY_20U: 	PUSH PSW
	MVI A,01H
LOOP_20U: 	DCR A
	JNZ LOOP_20U
	POP PSW
	RET

DELAY_1:	PUSH B
	PUSH D
	MVI B,2E
Loop1:	MVI C,6A
Loop2:	MVI D,1C
Loop3:	DCR D
	JNZ Loop3
	DCR C
	JNZ Loop2
	DCR B
	JNZ Loop1
	POP D
	POP B
	RET

DELAY: 	PUSH PSW
	MVI A,0FH
LOOP: 	DCR A
	JNZ LOOP
	POP PSW
	RET

LCD_INIT :    MVI A,24H
	OUT 01H
	MVI A,20H
	OUT 01H
	CALL DELAY
	MVI A,24H
	OUT 01H
	MVI A,20H
	OUT 01H
	CALL DELAY
	MVI A,84H
	OUT 01H
	MVI A,80H
	OUT 01H
	CALL DELAY
	MVI A,04H
	OUT 01H
	MVI A,00H
	OUT 01H
	CALL DELAY
	MVI A,E4H
	OUT 01H
	MVI A,E0H
	OUT 01H
	CALL DELAY
	MVI A,04H
	OUT 01H
	MVI A,00H
	OUT 01H
	CALL DELAY
	MVI A,64H
	OUT 01H
	MVI A,60H
	OUT 01H

LCD_SEND:   	PUSH PSW
	PUSH B
	PUSH D
	MOV B,A
	ANI F0H
	MVI D,0CH
	ORA D
	OUT 01H
	CALL DELAY
	ANI F8
	OUT 01H
	MOV A,B
	RLC
	RLC
	RLC
	RLC
	ANI F0H
	MVI D,0CH
	ORA D
	OUT 01H
	CALL DELAY
	ANI F8H
	OUT 01H
	POP D
	POP B
	POP PSW
	RET

ISR75: 	PUSH PSW
	PUSH B
	CPI 29H
	JNZ 
	POP B
	POP PSW
	DCR A
	EI
	RET

ISR_HELP:  	MVI A,00H
	OUT 03H
	IN 00H
	MOV C,A
	IN 00H
	MOV B,A
	
	
LCD_COMM:	CALL DELAY
	MVI A,5CH
	OUT 01H
	MVI A,58H
	OUT 01H
	CALL DELAY
	MVI A,7CH
	OUT 01H
	MVI A,78H
	OUT 01H
	CALL DELAY
	MVI A,4CH
	OUT 01H
	MVI A,48H
	OUT 01H
	CALL DELAY
	MVI A,5CH
	OUT 01H
	MVI A,58H
	OUT 01H
	CALL DELAY
	MVI A,4CH
	OUT 01H
	MVI A,48H
	OUT 01H
	CALL DELAY
	MVI A,CCH
	OUT 01H
	MVI A,C8H
	OUT 01H
	CALL DELAY
	MVI A,4CH
	OUT 01H
	MVI A,48H
	OUT 01H
	CALL DELAY
	MVI A,3CH
	OUT 01H
	MVI A,38H
	OUT 01H
	CALL DELAY
	MVI A,4CH
	OUT 01H
	MVI A,48H
	OUT 01H
	CALL DELAY
	MVI A,FCH
	OUT 01H
	MVI A,F8H
	OUT 01H
	CALL DELAY
	MVI A,4CH
	OUT 01H
	MVI A,48H
	OUT 01H
	CALL DELAY
	MVI A,DCH
	OUT 01H
	MVI A,D8H
	OUT 01H
	CALL DELAY
	MVI A,4CH
	OUT 01H
	MVI A,48H
	OUT 01H
	CALL DELAY
	MVI A,5CH
	OUT 01H
	MVI A,58H
	OUT 01H
	CALL DELAY
	MVI A,2CH
	OUT 01H
	MVI A,28H
	OUT 01H
	CALL DELAY
	MVI A,1CH
	OUT 01H
	MVI A,18H
	OUT 01H
